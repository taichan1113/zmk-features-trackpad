## dts/bindings/input/zmk,travelers-pad-canonical-wheel-input.yaml
```yaml
description: |
  Private pre-processor canonical wheel observation device. No host listener
  or input processors may be attached; it is not a mouse output endpoint.
  processor前の標準wheelを観測する専用device。HID listenerやprocessorを接続しない。
compatible: "zmk,travelers-pad-canonical-wheel-input"
include: base.yaml
```

## dts/bindings/input/zmk,travelers-pad-contact-session-manager.yaml
```yaml
description: Travelers Pad normalized contact session manager
compatible: "zmk,travelers-pad-contact-session-manager"
include: base.yaml
properties:
  extra-contact-confirm-ms:
    type: int
    default: 35
    description: |
      Confirm a second contact added during a one-contact stream for this duration.
      Initial multi-contact touches and full release are immediate. Zero disables
      confirmation. Recognizers share the same filtered slot/count frame.
      継続中の1本指への2本目追加の確認時間。初回多指接触と全解除は即時。
      0で無効。全認識器は同一の安定化slot/count frameを見る。
  input-device:
    type: phandle
    required: true
    description: IQS9150 normalized raw contact input
```

## dts/bindings/input/zmk,travelers-pad-iqs9150-edge-hold-continue.yaml
```yaml
description: Travelers Pad IQS9150 edge-hold continuation function

compatible: "zmk,travelers-pad-iqs9150-edge-hold-continue"

include: base.yaml

properties:
  drag-input-device:
    type: phandle
    required: true
    description: Raw IQS9150 contact stream used while a confirmed drag is active
  scroll-input-device:
    type: phandle
    required: true
    description: Router output stream used only after two-finger scroll is committed
  scroll-motion-input-device:
    type: phandle
    required: true
    description: Canonical wheel stream emitted by the pointer function after its axis lock
  scroll-output-device:
    type: phandle
    required: true
    description: Pointer function device used to re-enter its normal wheel listener chain
  surface-x:
    type: int
    default: 2000
    description: Usable pad width in IQS9150 absolute coordinates
  surface-y:
    type: int
    default: 1213
    description: Usable pad height in IQS9150 absolute coordinates
  edge-size:
    type: int
    default: 80
    description: Width of the physical boundary zone that arms continuation detection
  drag-start-delay-ms:
    type: int
    default: 120
    description: Hold time at an edge before virtual drag motion begins
  drag-repeat-ms:
    type: int
    default: 24
    description: Period of virtual drag motion while an edge remains held
  drag-repeat-delta:
    type: int
    default: 8
    description: Relative-coordinate delta emitted on each virtual drag-motion period
  scroll-start-delay-ms:
    type: int
    default: 120
    description: Hold time at an edge before virtual scroll begins
  scroll-repeat-ms:
    type: int
    default: 24
    description: Period of virtual scroll while an edge remains held
  scroll-repeat-delta:
    type: int
    default: 4
    description: Relative wheel delta emitted on each virtual scroll period
```

## dts/bindings/input/zmk,travelers-pad-iqs9150-matrix-input.yaml
```yaml
description: Travelers Pad IQS9150 active-touch input isolation function

compatible: "zmk,travelers-pad-iqs9150-matrix-input"

include: base.yaml

properties:
  input-device:
    type: phandle
    required: true
    description: Raw IQS9150 contact input device

  one-finger-settle-ms:
    type: int
    default: 45
    description: >
      Confirmation interval before forwarding one-finger contact to the grid.
      多指接触の開始を格子接触と誤認しないための1本指接触確定時間（ms）。
```

## dts/bindings/input/zmk,travelers-pad-iqs9150-multifinger-router.yaml
```yaml
description: Travelers Pad IQS9150 exclusive multi-finger gesture router

compatible: "zmk,travelers-pad-iqs9150-multifinger-router"

include: base.yaml

properties:
  transform-device:
    type: phandle
    description: |
      Optional transform recognizer configuration. Geometry exclusion follows
      its pinch-disabled/rotation-disabled properties, node status and CONFIG.
      When omitted, preserve legacy exclusion of both geometry types.
      任意のtransform設定参照。個別無効化・ノード状態・CONFIGに識別抑止を合わせる。
      省略時は従来どおり両ジオメトリを除外する。
  input-device:
    type: phandle
    required: true
    description: Raw IQS9150 contact input device
  scroll-classify-move:
    type: int
    default: 35
    description: Minimum movement required from each direction-coherent contact before committing two-finger scroll
  geometry-distance-threshold:
    type: int
    default: 30000
    description: Squared-distance change that claims pinch geometry
  geometry-rotation-threshold:
    type: int
    default: 30000
    description: Cross-product magnitude that claims rotation geometry
```

## dts/bindings/input/zmk,travelers-pad-iqs9150-pointer.yaml
```yaml
description: Travelers Pad IQS9150 pointer and scroll function

compatible: "zmk,travelers-pad-iqs9150-pointer"

include: base.yaml

properties:
  input-device:
    type: phandle
    required: true
    description: IQS9150 raw contact input device
  scroll-axis-lock-min-move:
    type: int
    default: 12
    description: >
      Accumulated coordinate movement required before locking a two-finger
      scroll axis. 2本指スクロールの軸を決定するまでに蓄積する座標移動量。
  scroll-axis-lock-ratio:
    type: int
    default: 2
    description: >
      Horizontal-to-vertical ratio required to choose horizontal scrolling;
      otherwise vertical is selected. 横スクロールを選ぶために必要な横/縦移動比。
      それ以外は縦スクロールを選ぶ。
  scroll-max-frame-delta:
    type: int
    default: 128
    description: >
      Per-frame coordinate delta above which a scroll frame is discarded and
      rebased. この値を超える1フレーム差分は破棄して座標基準を更新する。
```

## dts/bindings/input/zmk,travelers-pad-iqs9150-tap-drag.yaml
```yaml
description: Travelers Pad IQS9150 one-to-three-finger tap and double-tap drag function

compatible: "zmk,travelers-pad-iqs9150-tap-drag"

include: base.yaml

properties:
  input-device:
    type: phandle
    required: true
    description: IQS9150 raw contact input device
  tap-max-ms:
    type: int
    default: 180
    description: Maximum duration of either tap in milliseconds
  tap-max-move:
    type: int
    default: 75
    description: Maximum primary-contact movement during a tap
  multifinger-settle-ms:
    type: int
    default: 45
    description: >
      Ignore contact-coordinate settling for this interval after a second or
      third finger appears. 2本目または3本目の検出直後に、接触座標の安定化を
      タップ移動として判定しない時間（ms）。
  double-tap-max-gap-ms:
    type: int
    default: 250
    description: Maximum all-fingers-up interval between the two taps
  double-tap-max-distance:
    type: int
    default: 120
    description: Maximum start-position difference between two taps
  drag-start-move:
    type: int
    default: 20
    description: One-finger second-tap movement needed to start dragging immediately
```

## dts/bindings/input/zmk,travelers-pad-iqs9150-tip-tap-kscan.yaml
```yaml
description: Travelers Pad two-finger Tip-Tap virtual KSCAN
compatible: "zmk,travelers-pad-iqs9150-tip-tap-kscan"
include: base.yaml
properties:
  input-device: {type: phandle, required: true}
  anchor-min-hold-ms:
    type: int
    default: 250
    description: Minimum stationary one-finger anchor time before adding the second contact. Already-owned repeated Tip-Taps do not wait again. Zero retains immediate acquisition.
  second-contact-timeout-ms: {type: int, default: 180}
  contact-slop: {type: int, default: 75}
  minimum-horizontal-separation: {type: int, default: 160}
  direction-inverted: {type: boolean}
  anchor-hold:
    type: boolean
    description: Hold virtual row 0 column 2 after the first accepted Tip-Tap until anchor loss or cancellation. Assign its modifier separately from left/right keys. Default off.
```

## dts/bindings/input/zmk,travelers-pad-iqs9150-transform-gesture.yaml
```yaml
description: Travelers Pad IQS9150 two-finger pinch and rotation primary recognizer

compatible: "zmk,travelers-pad-iqs9150-transform-gesture"

include: [kscan.yaml, base.yaml]

properties:
  pinch-disabled:
    type: boolean
    description: Disable pinch recognition, ownership proposals and output / ピンチ認識・所有権要求・出力を無効化
  rotation-disabled:
    type: boolean
    description: Disable rotation recognition, ownership proposals and output / 回転認識・所有権要求・出力を無効化
  input-device:
    type: phandle
    required: true
    description: Normalized contact-session input device
  distance-threshold:
    type: int
    default: 30000
    description: Squared-distance change required to classify a pinch
  rotation-threshold:
    type: int
    default: 30000
    description: Cross-product magnitude required to classify a rotation
  pinch-step-threshold:
    type: int
    default: 30000
    description: Squared-distance change required for each additional pinch action
  rotation-step-threshold:
    type: int
    default: 30000
    description: Cross-product magnitude required for each additional rotation action
```

## dts/bindings/input/zmk,travelers-pad-scroll-inertia.yaml
```yaml
description: Travelers Pad two-finger scroll inertia function

compatible: "zmk,travelers-pad-scroll-inertia"

include: base.yaml

properties:
  half-life-ms:
    type: int
    default: 0
    description: |
      Velocity half-life in ms. Nonzero selects time-based fixed-point inertia;
      zero preserves legacy per-report integer decay.
      速度の半減時間。非ゼロは時間基準の固定小数点慣性、0は従来の整数減衰。
  velocity-window-ms:
    type: int
    default: 80
    description: Velocity smoothing window for time-based mode / 時間基準モードの速度平滑化時間
  release-timeout-ms:
    type: int
    default: 120
    description: Maximum age of the last physical wheel motion at release / 解放時に許容する最終移動の古さ
  max-duration-ms:
    type: int
    default: 3000
    description: Safety duration limit for time-based inertia / 時間基準慣性の最大継続時間
  stop-speed:
    type: int
    default: 20
    description: Stop below this raw sensor-counts/second velocity in time-based mode / 時間基準モードの停止速度（生センサーcount毎秒）
  contact-input-device:
    type: phandle
    required: true
    description: Raw IQS9150 stream used to identify physical contact release
  wheel-input-device:
    type: phandle
    required: true
    description: |
      Private zmk,travelers-pad-canonical-wheel-input device, without a host
      listener or processors. Must differ from wheel-output-device. The broker
      copies raw values from wheel-output-device to this source before scaling.
      専用wheel観測device。出力deviceと分離しHID listener・processorを接続しない。
      brokerが出力deviceの倍率適用前の値をこの観測sourceへ複製する。
  wheel-output-device:
    type: phandle
    required: true
    description: Pointer device used to re-enter the normal wheel listener chain
  start-delay-ms:
    type: int
    default: 20
    description: Delay after two-finger release before inertia begins
  repeat-ms:
    type: int
    default: 24
    description: Period between inertia wheel reports
  decay-numerator:
    type: int
    default: 3
    description: Numerator of per-report velocity decay
  decay-denominator:
    type: int
    default: 4
    description: Denominator of per-report velocity decay
  stop-delta:
    type: int
    default: 2
    description: Absolute raw wheel delta below which inertia stops
  max-delta:
    type: int
    default: 64
    description: Maximum absolute raw wheel delta accepted from one physical report
```

## dts/bindings/kscan/zmk,travelers-pad-iqs9150-edge-dial-kscan.yaml
```yaml
description: Travelers Pad IQS9150 continuous edge-trace virtual KSCAN
compatible: "zmk,travelers-pad-iqs9150-edge-dial-kscan"
include: [kscan.yaml, base.yaml]
properties:
  rows:
    type: int
    required: true
  columns:
    type: int
    required: true
  input-device:
    type: phandle
    required: true
  surface-x:
    type: int
    default: 2000
  surface-y:
    type: int
    default: 1213
  edge-size:
    type: int
    default: 140
  step-move:
    type: int
    default: 80
  circle-entry-depth:
    type: int
    default: 80
  circle-entry-span:
    type: int
    default: 250
  circle-step-move:
    type: int
    default: 80
  circle-corner-inset-x:
    type: int
    default: 360
    description: Horizontal inset of dynamic corner circle centres.
  circle-corner-inset-y:
    type: int
    default: 313
    description: Vertical inset of dynamic corner circle centres.
  edge-left:
    type: boolean
  edge-right:
    type: boolean
  edge-top:
    type: boolean
  edge-bottom:
    type: boolean
```

## dts/bindings/kscan/zmk,travelers-pad-iqs9150-grid-kscan.yaml
```yaml
description: Travelers Pad IQS9150 grid and edge gesture virtual KSCAN

compatible: "zmk,travelers-pad-iqs9150-grid-kscan"

include: [kscan.yaml, base.yaml]

properties:
  input-device:
    type: phandle
    required: true
    description: IQS9150 raw contact input device
  rows:
    type: int
    required: true
  columns:
    type: int
    required: true
  surface-x:
    type: int
    default: 2000
  surface-y:
    type: int
    default: 1213
  edge-size:
    type: int
    default: 0
    description: Width of enabled edge zones in sensor coordinate units
  edge-keys:
    type: array
    required: false
    description: Eight cells, left/right/top/bottom as row,column pairs
  tap-max-ms:
    type: int
    default: 350
  tap-max-move:
    type: int
    default: 75
```

## dts/bindings/kscan/zmk,travelers-pad-iqs9150-multifinger-gesture-kscan.yaml
```yaml
description: Travelers Pad IQS9150 three/four-finger swipe and five-finger geometry virtual KSCAN

compatible: "zmk,travelers-pad-iqs9150-multifinger-gesture-kscan"

include: [kscan.yaml, base.yaml]

properties:
  four-finger-hold-ms:
    type: int
    default: 0
    description: Optional stationary four-finger hold duration; zero disables. Reports row 2 column 2 after all contacts lift.
  four-finger-hold-slop:
    type: int
    default: 60
    description: Maximum per-contact X or Y displacement during the hold in sensor units.
  input-device:
    type: phandle
    required: true
    description: IQS9150 raw contact input device
  swipe-min-move:
    type: int
    default: 180
    description: Minimum centroid displacement required for a swipe
  swipe-max-ms:
    type: int
    default: 700
    description: Maximum contact duration accepted as a swipe
  five-finger-radial-move:
    type: int
    default: 80
    description: Per-contact radial movement required for five-finger grasp/release recognition
  five-finger-stable-frames:
    type: int
    default: 3
    description: Consecutive complete five-contact frames required before capturing a geometry baseline
```
